## package/classifier/Config.in
```kconfig
config BR2_PACKAGE_CLASSIFIER
	bool "classifier"
	help
	  Onboard emitter detector and signal classifier. Connects to
	  maia-httpd's /waterfall feed as a WebSocket client (plain
	  TCP, no libwebsockets), finds wide blocks (LTE, DVB-T, DAB,
	  Wi-Fi) and narrow emitters (FM, GSM, carriers, bursts),
	  measures them in Hz, labels them from bandwidth, shape,
	  burstiness, band and channel raster, flags board clock
	  harmonics as spurs, and publishes the best one on
	  state/classifier/* plus the full list on
	  state/classifier/emitters. No templates are used.
```
